## drivers/char/broadcom/Kconfig
```kconfig
#
# Broadcom char driver config
#

menuconfig BRCM_CHAR_DRIVERS
	bool "Broadcom Char Drivers"
	help
	  Broadcom's char drivers

if BRCM_CHAR_DRIVERS

config BCM_VC_CMA
	bool "Videocore CMA"
	depends on CMA && BRCM_CHAR_DRIVERS && BCM2708_VCHIQ
	default n
        help
          Helper for videocore CMA access.

config BCM_VC_SM
	tristate "VMCS Shared Memory"
	depends on BRCM_CHAR_DRIVERS
	default n
	help
	Support for the VC shared memory on the Broadcom reference
	design. Uses the VCHIQ stack.

config BCM_VC_DNFO
	tristate "Videocore Display Information"
	depends on BRCM_CHAR_DRIVERS
	default n
        help
          Tracker for videocore display capabilities, used in integration
          with Android.
endif
```
